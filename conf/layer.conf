## conf/layer.conf
```bitbake
# We have a conf and classes directory, add to BBPATH
BBPATH .= ":${LAYERDIR}"

# We have recipes-* directories, add to BBFILES
BBFILES += "${LAYERDIR}/recipes-*/*/*.bb \
            ${LAYERDIR}/recipes-*/*/*.bbappend"

BBFILE_COLLECTIONS += "meta-adlink-amd"
BBFILE_PATTERN_meta-adlink-amd := "^${LAYERDIR}/"

# Additional license directories.
#LICENSE_PATH += "${LAYERDIR}/custom-licenses"

# This should only be incremented on significant changes that will
# cause compatibility issues with other layers
LAYERVERSION_meta-adlink-amd = "6"
LAYERSERIES_COMPAT_meta-adlink-amd = " scarthgap"
```
